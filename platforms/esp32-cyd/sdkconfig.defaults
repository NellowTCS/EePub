## platforms/esp32-cyd/sdkconfig.defaults
```kconfig
# Enable Arduino as component and autostart
CONFIG_AUTOSTART_ARDUINO=y
CONFIG_ENABLE_ARDUINO_DEPENDS=y
CONFIG_ARDUINO_RUNNING_CORE=1
CONFIG_ARDUINO_LOOP_STACK_SIZE=8192
CONFIG_ARDUINO_EVENT_RUNNING_CORE=1
CONFIG_ARDUINO_UDP_RUN_CORE0=y

# Partition table
CONFIG_PARTITION_TABLE_CUSTOM=y
CONFIG_PARTITION_TABLE_CUSTOM_FILENAME="partitions.csv"

# Flash
CONFIG_ESPTOOLPY_FLASHSIZE_4MB=y
CONFIG_ESPTOOLPY_FLASHSIZE="4MB"

# FreeRTOS
CONFIG_FREERTOS_HZ=1000
```
